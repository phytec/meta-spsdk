## conf/layer.conf
```bitbake
# We have a conf and classes directory, add to BBPATH
BBPATH .= ":${LAYERDIR}"

# We have recipes-* directories, add to BBFILES
BBFILES += "${LAYERDIR}/recipes-*/*/*.bb \
            ${LAYERDIR}/recipes-*/*/*.bbappend"

BBFILE_COLLECTIONS += "meta-spsdk"
BBFILE_PATTERN_meta-spsdk = "^${LAYERDIR}/"
BBFILE_PRIORITY_meta-spsdk = "6"

LAYERDEPENDS_meta-spsdk = "meta-python core"
LAYERSERIES_COMPAT_meta-spsdk = "wrynose"

BBFILES_DYNAMIC += " \
    fsl-bsp-release:${LAYERDIR}/dynamic-layers/fsl-bsp-release/recipes-*/*/*.bb \
    fsl-bsp-release:${LAYERDIR}/dynamic-layers/fsl-bsp-release/recipes-*/*/*.bbappend \
"

LAYERRECOMMENDS_phytec = "\
    fsl-bsp-release \
"
```
